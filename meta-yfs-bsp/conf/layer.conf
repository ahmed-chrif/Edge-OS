## meta-yfs-distro/conf/distro/yfs.conf
```bitbake
DISTRO = "yfs"
DISTRO_NAME = "YFS Distribution"
DISTRO_VERSION = "1.0"
DISTRO_CODENAME = "scarthgap"

INIT_MANAGER = "systemd"
PACKAGE_CLASSES = "package_rpm"
PACKAGECONFIG:append:pn-systemd = " sysext cryptsetup"

PREFERRED_PROVIDER_base-utils = "packagegroup-core-base-utils"
VIRTUAL-RUNTIME_base-utils = "packagegroup-core-base-utils"

LICENSE_FLAGS_ACCEPTED:append = " commercial"
LICENSE_FLAGS_ACCEPTED:append = " commercial_ffmpeg"

# only install necessairy packages
NO_RECOMMENDATION = "1"

# enable extra build informations 
USER_CLASSES ?= "buildhistory buildstats buildstats-summary"

PREMIRRORS ??= "\
bzr://.*/.*   http://downloads.yoctoproject.org/mirror/sources/ \n \
cvs://.*/.*   http://downloads.yoctoproject.org/mirror/sources/ \n \
git://.*/.*   http://downloads.yoctoproject.org/mirror/sources/ \n \
gitsm://.*/.* http://downloads.yoctoproject.org/mirror/sources/ \n \
hg://.*/.*    http://downloads.yoctoproject.org/mirror/sources/ \n \
osc://.*/.*   http://downloads.yoctoproject.org/mirror/sources/ \n \
p4://.*/.*    http://downloads.yoctoproject.org/mirror/sources/ \n \
svn://.*/.*   http://downloads.yoctoproject.org/mirror/sources/ \n"

MIRRORS =+ "\
ftp://.*/.*      http://downloads.yoctoproject.org/mirror/sources/ \n \
http://.*/.*     http://downloads.yoctoproject.org/mirror/sources/ \n \
https://.*/.*    http://downloads.yoctoproject.org/mirror/sources/ \n"



# Template for feed server
PACKAGE_FEED_URIS ?= "http://<feedserver>:8000/"

# Use Hash Equivalence
BB_SIGNATURE_HANDLER = "OEEquivHash"
# Start a local hashserver instance
BB_HASHSERVE = "auto"


# Keep only the top commit of git repos
BB_GIT_SHALLOW = "1"
BB_GIT_SHALLOW_DEPTH = "1"

# set to "1" Allow reusing DL_DIR from the current build as a mirror for other builds.
# this makes do_fetch tasks take significantly longer
BB_GENERATE_MIRROR_TARBALLS = "0"

# This defaults to enabled if both BB_GIT_SHALLOW and
# BB_GENERATE_MIRROR_TARBALLS are enabled
BB_GENERATE_SHALLOW_TARBALLS = "0"

TCLIBCAPPEND = ""

BUILDHISTORY_COMMIT ?= "1"

# Do not use verbose logs for cmake, this reduces build logs significantly, for recipes
# e.g. qtwebkit from 163M down to < 1M
CMAKE_VERBOSE ?= ""

require conf/distro/include/security_flags.inc
require conf/distro/include/no-static-libs.inc
require conf/distro/include/yocto-uninative.inc
INHERIT += "uninative"

# Dont package kernel into image
RDEPENDS:${KERNEL_PACKAGE_NAME}-base = ""

DISTRO_FEATURES = "\
    acl \
    ext2 \
    ipv4 \
    ipv6 \
    pcmcia \
    usbhost \
    wifi \
    bluetooth \
    xattr \
    zeroconf \
    vfat \
    seccomp \
    systemd \
    usrmerge \
    opengl \
    pulseaudio \
    polkit \
    virtualization \
"

DISTRO_FEATURES += "x11"
USE_REDUNDANT_FLASH_LAYOUT_DEFAULT = "1"
```
